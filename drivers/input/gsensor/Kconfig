## drivers/input/gsensor/Kconfig
```kconfig
#
# gsensor drivers configuration
#

menuconfig G_SENSOR_DEVICE
	bool "g_sensor device support"
	help
	  Enable this to be able to choose the drivers for controlling the
	  g_sensor on some platforms, for example on PDAs.

if G_SENSOR_DEVICE

config SENSORS_STK8313
    tristate"Sensortek stk8313 accelerometer"
    depends on I2C
    help
        If you say yes here you get support for the stk8313.

if (!SENSORS_STK8313)
config SENSORS_STK8312
    tristate"Sensortek stk8312 accelerometer"
    default y
    depends on I2C
    help
        If you say yes here you get support for the stk8312.
endif # if (!SENSORS_STK8313)
config GS_MMA7660
  bool "gs_mma7660"
	help	 
	  To have support for your specific gsesnor you will have to
	  select the proper drivers which depend on this option.

config GS_MMA8452
  bool "gs_mma8452"
	help	 
	  To have support for your specific gsesnor you will have to
	  select the proper drivers which depend on this option.

config GS_LIS3DH
  bool "gs_lis3dh"
	help	 
	  To have support for your specific gsesnor you will have to
	  select the proper drivers which depend on this option.
	  
config GS_L3G4200D
  bool "gs_l3g4200d"
	help	 
	  To have support for your specific gsesnor you will have to
	  select the proper drivers which depend on this option.

config GS_BMA023
  bool "gs_bma023"
  help
    To have support for your specific gsesnor you will have to
    select the proper drivers which depend on this option.
endif
```
